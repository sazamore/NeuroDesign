/*
 * ERM_Discrimination.ino
 * Haptic Mimicry Course — Day 2 Lab
 *
 * Drives a DRV2605L in PWM/Analog Input mode.
 * TRIAL - Type TWO VALUES 1-5, one after the other, to run a pair (A then B).
 * CATCH - Press C to run a catch trial. Catch trials produce the same level twice, the level is chosen randomly.
 * Each catch or trial will run the full trial: 
 *     1) signal the motor run at first level for 800 ms.
 *     2) Pause for 1000 ms. 
 *     3) signal the motor to run at second level for 800 ms.
 *
 * Wiring:
 *   DRV2605L GND  -> Arduino GND
 *   DRV2605L VCC  -> Arduino 5V
 *   DRV2605L SDA  -> Arduino A4
 *   DRV2605L SCL  -> Arduino A5
 *   DRV2605L EN   -> Arduino 5V
 *   DRV2605L IN   -> Arduino pin 9  (PWM_PIN below)
 *   DRV2605L O+   -> motor red wire
 *   DRV2605L O-   -> motor blue wire
 *
 * Library: SparkFun DRV2605L (install via Library Manager)
 * AI-assisted code, generated by Dr. Z - February 2026
 */

#include <Wire.h>
#include <Sparkfun_DRV2605L.h>
SFE_HMD_DRV2605L HMD;

const int PWM_PIN       = 9;
const int BUZZ_DURATION = 800;    // ms motor runs per stimulus
const int GAP_DURATION  = 1000;   // ms silence between A and B

// SIGNAL SENSITIVTY: Adjust the level range to account for tactile sensitivity
const int   LEVELS[5]      = {64, 110, 160, 200, 255};
const char* LEVEL_NAMES[5] = {"1 (25%)", "2 (43%)", "3 (63%)", "4 (78%)", "5 (100%)"};

bool waitingForB = false;
int  levelA      = -1;

// ── helpers ──────────────────────────────────────────────────────────────────

void runBuzz(int pwmVal, int durationMs) {
  //
  analogWrite(PWM_PIN, pwmVal);
  delay(durationMs);
  analogWrite(PWM_PIN, 0);
}

void runPair(int idxA, int idxB, bool isCatch) {
  //runs two instances of the buzz stimulus
  Serial.print(isCatch ? "CATCH  — A: " : "PAIR   — A: ");
  Serial.print(LEVEL_NAMES[idxA]);
  Serial.print("  B: ");
  Serial.println(LEVEL_NAMES[idxB]);

  runBuzz(LEVELS[idxA], BUZZ_DURATION);
  delay(GAP_DURATION);
  runBuzz(LEVELS[idxB], BUZZ_DURATION);

  Serial.println("  [Complete — record response. Reveal trial type ONLY to the Recorder]");
}

// ── setup ────────────────────────────────────────────────────────────────────

void setup() {
  Serial.begin(9600);
  Wire.begin();
  HMD.begin();
  HMD.Mode(3);           // Select PWM/Analog Input mode
  HMD.MotorSelect(0x36); // Select ERM motor type
  analogWrite(PWM_PIN, 0);
  randomSeed(analogRead(A0)); // floating pin for randomness

  Serial.println("DRV2605L ready. Press the following keys to drive stimulus:");
  Serial.println("    1-5  : press once for stimulus A, again for stimulus B");
  Serial.println("    C/c  : runs a catch trial (same level twice, random)");
  Serial.println("---");
}


void loop() {
  if (!Serial.available()) return;
  char key = Serial.read();

  // ── catch trial ──────────────────────────────────────────────────────────
  if (key == 'C' || key == 'c') {
    if (waitingForB) {
      Serial.println("Cancelled pending A — running catch trial instead.");
      waitingForB = false;
      levelA = -1;
    }
    int idx = random(0, 5);
    runPair(idx, idx, true);
    return;
  }

  // ── test pair ─────────────────────────────────────────────────────────────
  if (key >= '1' && key <= '5') {
    int idx = key - '1';

    if (!waitingForB) {
      levelA      = idx;
      waitingForB = true;
      Serial.print("Stim A run: ");
      Serial.print(LEVEL_NAMES[levelA]);
      Serial.println("  — press 1-5 for B, or C to cancel with a catch trial");
      runBuzz(LEVELS[levelA], BUZZ_DURATION);

    } else {
      runPair(levelA, idx, false);
      waitingForB = false;
      levelA      = -1;
    }
  }
}